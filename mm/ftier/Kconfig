## mm/ftier/Kconfig
```kconfig
# SPDX-License-Identifier: GPL-2.0-only

menu "FTier Memory Tiering Support"

config FTIER
	bool "FTier memory tiering for bandwidth expansion"
	depends on X86_64 && NUMA && MMU
	depends on NUMA_BALANCING && MIGRATION && TRANSPARENT_HUGEPAGE
	depends on CGROUPS
	help
	  FTier tiers application memory between DRAM and CXL-attached
	  memory to expand usable memory bandwidth. Hotness is tracked with
	  Adaptive Frequency Scanning of the accessed bits of upper-level
	  page table entries, and hot pages are migrated in the direction
	  requested by a tier latency monitor.

	  FTier is controlled at runtime through /sys/kernel/mm/ftier and is
	  inactive until enabled there. See
	  Documentation/admin-guide/mm/ftier.rst.

	  If unsure, say N.

config FTIER_CHA_MONITOR
	tristate "FTier CHA tier latency monitor"
	depends on FTIER && CPU_SUP_INTEL
	default m
	help
	  A tier latency monitor for Intel Sapphire Rapids and Emerald
	  Rapids. It measures the load latency of the DRAM and CXL tiers
	  with the CHA uncore counters and requests promotion or demotion
	  so that both tiers see the same latency (the Colloid rule).

	  The module is called ftier_cha. It programs the CHA counters
	  directly, so perf uncore_cha events must not be used while it is
	  loaded.

config FTIER_KUNIT_TEST
	bool "KUnit tests for FTier" if !KUNIT_ALL_TESTS
	depends on FTIER && KUNIT=y
	default KUNIT_ALL_TESTS
	help
	  Unit tests of the FTier Hotlist, candidate selection, hint-fault
	  threshold, hotness level adaptation and tier signal. They run at
	  boot and leave FTier as they found it.

	  If unsure, say N.

endmenu
```
